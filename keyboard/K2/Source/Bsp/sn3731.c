/***************************************************************************************************
* FILE: sn3731.c
*
* DESCRIPTION:  --
*
* CREATED: 2018/8/6, by kevin
***************************************************************************************************/

/***************************************************************************************************
* INCLUDES
***************************************************************************************************/
#include "sn3731.h"
#include "i2c.h"
#include "string.h"
/***************************************************************************************************
* DEFINES
***************************************************************************************************/
#define SN3731_ADDR 0xE8

static uint8_t u8TmpVal[2] = {0};
#define SN3731_WriteByte(addr, dat) u8TmpVal[0] = addr; u8TmpVal[1] = dat; HAL_I2C_Master_Transmit(&hi2c3, SN3731_ADDR, u8TmpVal, 2, 1000)
#define SN3731_WriteNBytes(arr) HAL_I2C_Master_Transmit(&hi2c3, SN3731_ADDR, arr, sizeof(arr), 1000)


/***************************************************************************************************
* VARIABLES
***************************************************************************************************/
//32级亮度，肉眼均衡
const uint8_t SN3731_PWM_LIB[32] =
{
    0,   1,   2,   4,   7,  10,  13,  18,
    22,  28,  33,  39,  46,  53,  61,  69,
    78,  86,  96, 106, 116, 126, 138, 149,
    161, 173, 186, 199, 212, 226, 240, 255,
};

static uint8_t SN3731_FRAME_RAM[19] = {0};
static uint8_t SN3731_FRAME_REFRESH_FLAG = 0;

/***************************************************************************************************
* FUNCTION DECLARATION
***************************************************************************************************/



/***************************************************************************************************
* Description:  设置所有灯的亮度
***************************************************************************************************/
uint8_t SN3731_SetGlobalBright(uint8_t bright)
{
    uint8_t i, j;
    
    //所有亮度设置为0
    for(i=0; i<8; i++)
    {
        SN3731_WriteByte(0xFD, i);
        for(j=0x24; j<0xB3; j++)
        {
            SN3731_WriteByte(j, bright);
        }
    }
    
    return 0;
}

/***************************************************************************************************
* Description: 写入画面 
***************************************************************************************************/
uint8_t SN3731_RefreshFrame(void)
{
    if(SN3731_FRAME_REFRESH_FLAG)
    {
        SN3731_WriteByte(0xFD, 0);//设置页地址
        SN3731_WriteNBytes(SN3731_FRAME_RAM);
        SN3731_FRAME_REFRESH_FLAG = 0;
    }
    return 0;
}

/***************************************************************************************************
* Description:  根据键盘的按键号定义LED号，控制LED开关，缓存刷新后生效
***************************************************************************************************/
//#define L0  {8*4+2, 8*12+0}
//#define L1  {8*5+2, 8*13+0}
//#define L2  {8*2+2, 8*14+0}
//#define L3  {8*3+2, 8*15+0}
//#define L4  {8*0+2, 8*16+0}
//#define L5  {8*1+2, 8*17+0}
//
//#define L6  {8*4+3, 8*12+1}
//#define L7  {8*5+3, 8*13+1}
//#define L8  {8*2+3, 8*14+1}
//#define L9  {8*3+3, 8*15+1}
//#define L10 {8*0+3, 8*16+1}
//#define L11 {8*1+3, 8*17+1}
//
//
//#define L24 {8*4 +7, 8*12+5}
//#define L25 {8*5 +7, 8*2 +7}
//#define L26 {8*13+5, 8*3 +7}
//#define L27 {8*0 +7, 8*14+5}
//#define L28 {8*1 +7, 8*4 +8}
//#define L29 {8*12+6, 8*5 +8}
//#define L30 {8*2 +8, 8*13+6}
//#define L31 {8*3 +8, 8*0 +8}
//#define L32 {8*14+6, 8*1 +8}

static const uint8_t SN3731_LED_INDEX[33][4] = 
{
    { 5,  2, 13,  0},
    { 6,  2, 14,  0},
    { 3,  2, 15,  0},
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    {17,  5,  2,  7},
};

void SN3731_LedCtrl(uint16_t n, uint8_t onoff)
{    
    if(n >= 33) 
    {
        return;
    }
    
    if(onoff)
    {
        SN3731_FRAME_RAM[SN3731_LED_INDEX[n][0]] |= 1<<SN3731_LED_INDEX[n][1];      //开
        SN3731_FRAME_RAM[SN3731_LED_INDEX[n][2]] |= 1<<SN3731_LED_INDEX[n][3];
    }
    else
    {
        SN3731_FRAME_RAM[SN3731_LED_INDEX[n][0]] &= ~(1<<SN3731_LED_INDEX[n][1]);   //关
        SN3731_FRAME_RAM[SN3731_LED_INDEX[n][2]] &= ~(1<<SN3731_LED_INDEX[n][3]);
    }
    
    SN3731_FRAME_REFRESH_FLAG = 1;
}

/***************************************************************************************************
* Description:  LED驱动初始化
***************************************************************************************************/
void SN3731_Init(void)
{
    uint8_t i, j;
    
    SN3731_WriteByte(0xFD, 0x0B);
    SN3731_WriteByte(0x00, 0x00);//图片模式
    SN3731_WriteByte(0x01, 0x00);//图片模式画面选择
    SN3731_WriteByte(0x02, 0x00);//自动播放显示第一帧画面
    SN3731_WriteByte(0x03, 0x00);//自动播放控制2
    SN3731_WriteByte(0x05, 0x00);//不使用闪烁，使能全局PWM
    SN3731_WriteByte(0x06, 0x00);//亮度音乐随动关闭
    SN3731_WriteByte(0x08, 0x00);//呼吸控制1
    SN3731_WriteByte(0x09, 0x00);//呼吸控制2
    SN3731_WriteByte(0x0A, 0x00);//关闭显示
    SN3731_WriteByte(0x0B, 0x00);//AGC控制
    SN3731_WriteByte(0x0C, 0x00);//ADC采样频率
    
    //第一页
    SN3731_WriteByte(0xFD, 0);
    
    //关闭所有的灯
    for(i=0; i<8; i++)
    {
        SN3731_WriteByte(0xFD, i);//设置页地址
        for(j=0; j<0x12; j++)
        {
            SN3731_WriteByte(j, 0);//关灯
        }
    }
    
    //全局闪烁关闭
    for(i=0; i<8; i++)
    {
        SN3731_WriteByte(0xFD, i);//设置页地址
        for(j=0x12; j<0x24; j++)
        {
            SN3731_WriteByte(j, 0);//关闭闪烁
        }
    }
    
    //所有亮度设置为0
    for(i=0; i<8; i++)
    {
        SN3731_WriteByte(0xFD, i);
        for(j=0x24; j<0xB3; j++)
        {
            SN3731_WriteByte(j, 255);
        }
    }
    
    memset(SN3731_FRAME_RAM, 0, sizeof(SN3731_FRAME_RAM));

    SN3731_WriteByte(0xFD, 0x0B);
    SN3731_WriteByte(0x0A, 0x01);//打开显示
    
//    for(int i=0; i<33; i++)
//    {
//        SN3731_LedCtrl(i, 1);
//        j = i;
//        SN3731_RefreshFrame();
//        HAL_Delay(10);
//    }
}

//uint8_t bright = 255;
//void SetBright(void)
//{
//    uint8_t i,j;
//    for(i=0; i<8; i++)
//    {
//        SN3731_WriteByte(0xFD, i);
//        for(j=0x24; j<0xB3; j++)
//        {
//            SN3731_WriteByte(j, bright);
//        }
//    }
//}

/****************************************** END OF FILE *******************************************/
